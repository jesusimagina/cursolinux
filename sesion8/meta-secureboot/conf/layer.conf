## sesion8/meta-secureboot/conf/layer.conf
```bitbake
# We have a conf and classes directory, add to BBPATH
BBPATH .= ":${LAYERDIR}"

# We have recipes-* directories, add to BBFILES
BBFILES += "${LAYERDIR}/recipes-*/*/*.bb \
            ${LAYERDIR}/recipes-*/*/*.bbappend"

BBFILE_COLLECTIONS += "meta-secureboot"
BBFILE_PATTERN_meta-secureboot = "^${LAYERDIR}/"
BBFILE_PRIORITY_meta-secureboot = "6"

LAYERDEPENDS_meta-secureboot = "core"
LAYERSERIES_COMPAT_meta-secureboot = "dunfell"
```
